## conf/machine/khadas-edge2.conf
```bitbake
# Copyright (c) 2021, Rockchip Electronics Co., Ltd
# Released under the MIT license (see COPYING.MIT for the terms)

#@TYPE: Machine
#@NAME: Khadas Edge2

require conf/machine/include/khadas-edge2.inc

KERNEL_DEVICETREE = "rockchip/rk3588s-khadas-edge2.dtb"

UBOOT_MACHINE = "khadas-edge2-rk3588s_defconfig"

RK_WIFIBT_RRECOMMENDS = " \
	rkwifibt-firmware-ap6275p-wifi \
	rkwifibt-firmware-ap6275-bt \
	brcm-tools \
"
```
